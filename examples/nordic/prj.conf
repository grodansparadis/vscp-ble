## CMakeLists.txt
```
# VSCP BLE node for Nordic nRF52/nRF53/nRF54L (nRF Connect SDK 3.x)
cmake_minimum_required(VERSION 3.20.0)

# This repository is the vscp-ble Zephyr module
list(APPEND EXTRA_ZEPHYR_MODULES ${CMAKE_CURRENT_SOURCE_DIR}/../..)

find_package(Zephyr REQUIRED HINTS $ENV{ZEPHYR_BASE})
project(vscp_ble_nordic)

# The BLE node itself is shared with the Zephyr example
target_include_directories(app PRIVATE ../zephyr/src)
target_sources(app PRIVATE src/main.c ../zephyr/src/vscp_node.c)
```

## Kconfig
```
# VSCP BLE node for nRF Connect SDK
rsource "../zephyr/Kconfig.node"
source "Kconfig.zephyr"
```

## sample.yaml
```
sample:
  name: VSCP BLE node (Nordic)
  description: VSCP over Bluetooth LE (E1, A2, G1) reference node for Nordic DKs
common:
  tags: bluetooth vscp
  sysbuild: true
tests:
  vscp_ble.nordic:
    platform_allow:
      - nrf52840dk/nrf52840
      - nrf5340dk/nrf5340/cpuapp
      - nrf54l15dk/nrf54l15/cpuapp
    integration_platforms:
      - nrf52840dk/nrf52840
```

## sysbuild.conf
```
# nRF5340: the Bluetooth controller runs on the network core (ipc_radio)
SB_CONFIG_NETCORE_IPC_RADIO=y
SB_CONFIG_NETCORE_IPC_RADIO_BT_HCI_IPC=y
```

## prj.conf
```kconfig
# VSCP BLE node - nRF Connect SDK 3.x, SoftDevice Controller
CONFIG_VSCP_BLE=y
CONFIG_VSCP_BLE_CRYPTO_PSA=y
# Nordic's PSA crypto (CryptoCell/CRACEN hardware AES where available)
CONFIG_NRF_SECURITY=y
CONFIG_PSA_WANT_ALG_CCM=y
CONFIG_PSA_WANT_KEY_TYPE_AES=y

CONFIG_BT=y
CONFIG_BT_PERIPHERAL=y
CONFIG_BT_BROADCASTER=y
CONFIG_BT_EXT_ADV=y
CONFIG_BT_EXT_ADV_MAX_ADV_SET=3
CONFIG_BT_DEVICE_NAME="VSCP BLE node"
CONFIG_BT_MAX_CONN=1
CONFIG_BT_MAX_PAIRED=4
CONFIG_BT_SMP=y
CONFIG_BT_SMP_SC_ONLY=y
CONFIG_BT_BONDABLE=y
CONFIG_BT_L2CAP_TX_MTU=247
CONFIG_BT_BUF_ACL_RX_SIZE=251
CONFIG_BT_BUF_ACL_TX_SIZE=251

CONFIG_BT_SETTINGS=y
CONFIG_SETTINGS=y
CONFIG_FLASH=y
CONFIG_FLASH_MAP=y
CONFIG_NVS=y

CONFIG_DK_LIBRARY=y
CONFIG_HWINFO=y
CONFIG_SENSOR=y
CONFIG_LOG=y
CONFIG_MAIN_STACK_SIZE=4096
CONFIG_SYSTEM_WORKQUEUE_STACK_SIZE=4096
CONFIG_BT_RX_STACK_SIZE=4096
```

## boards/nrf52840dk_nrf52840.conf
```kconfig
# SoftDevice Controller on this core: three extended advertising sets with
# room for a maximum-size (256-octet) E1/A2 frame
CONFIG_BT_CTLR_ADV_EXT=y
CONFIG_BT_CTLR_ADV_SET=3
CONFIG_BT_CTLR_ADV_DATA_LEN_MAX=512
```

## boards/nrf54l15dk_nrf54l15_cpuapp.conf
```kconfig
# nRF54L: RRAM, settings on ZMS
CONFIG_NVS=n
CONFIG_ZMS=y

# SoftDevice Controller on this core: three extended advertising sets with
# room for a maximum-size (256-octet) E1/A2 frame
CONFIG_BT_CTLR_ADV_EXT=y
CONFIG_BT_CTLR_ADV_SET=3
CONFIG_BT_CTLR_ADV_DATA_LEN_MAX=512
```

## src/main.c
```c
/*
 * VSCP BLE node for Nordic development kits (nRF Connect SDK 3.x)
 *
 *   west build -b nrf52840dk/nrf52840 examples/nordic
 *   west build -b nrf5340dk/nrf5340/cpuapp examples/nordic   (sysbuild adds ipc_radio)
 *   west build -b nrf54l15dk/nrf54l15/cpuapp examples/nordic
 *
 * Sends the die temperature (CLASS1.MEASUREMENT / TEMPERATURE) every
 * CONFIG_VSCP_NODE_PERIOD_MS over E1, A2 and G1.
 *
 *   Button 1  send CLASS1.INFORMATION BUTTON (pressed/released)
 *   Button 2  hold at reset: erase all bonds
 *   LED 1     blinks while advertising, on when connected
 *   LED 2     on when the central is authorized (G1 event access)
 *
 * The MIT License (MIT)
 * Copyright (c) 2000-2026 Ake Hedman, the VSCP Project <info@grodansparadis.com>
 */

#include <string.h>

#include <dk_buttons_and_leds.h>
#include <zephyr/device.h>
#include <zephyr/drivers/hwinfo.h>
#include <zephyr/drivers/sensor.h>
#include <zephyr/kernel.h>
#include <zephyr/logging/log.h>

#include "vscp-ble-g1.h"
#include "vscp_node.h"

LOG_MODULE_REGISTER(main, LOG_LEVEL_INF);

#define VSCP_CLASS1_MEASUREMENT           10
#define VSCP_TYPE_MEASUREMENT_TEMPERATURE 6
#define VSCP_CLASS1_INFORMATION           20
#define VSCP_TYPE_INFORMATION_BUTTON      1

#if DT_HAS_COMPAT_STATUS_OKAY(nordic_nrf_temp)
static const struct device *const temp_dev = DEVICE_DT_GET_ONE(nordic_nrf_temp);
#else
static const struct device *const temp_dev = NULL;
#endif

static volatile bool advertising;

static void
on_state(vscp_node_state_t state)
{
  switch (state) {
    case VSCP_NODE_ADVERTISING:
      advertising = true;
      break;
    case VSCP_NODE_CONNECTED:
      advertising = false;
      dk_set_led_on(DK_LED1);
      break;
    case VSCP_NODE_AUTHORIZED:
      dk_set_led_on(DK_LED2);
      break;
    case VSCP_NODE_DISCONNECTED:
      dk_set_led_off(DK_LED1);
      dk_set_led_off(DK_LED2);
      break;
    default:
      break;
  }
}

static uint8_t
on_event(const vscp_ble_event_t *ev)
{
  // Validate the VSCP event and authorize it by class/type before acting
  LOG_INF("G1 event: class %u type %u, %u octets", ev->vscp_class, ev->vscp_type, ev->size);
  return VSCP_BLE_G1_OK;
}

static uint8_t
authorize(const void *peer)
{
  ARG_UNUSED(peer);
  return IS_ENABLED(CONFIG_VSCP_NODE_AUTHORIZE_BONDED) ? VSCP_BLE_G1_AUTH_EVENT : VSCP_BLE_G1_AUTH_NONE;
}

// Button events are sent from a work item (not the button callback)
static uint8_t button_state;
static void
button_work_handler(struct k_work *work)
{
  ARG_UNUSED(work);
  // CLASS1.INFORMATION data: index, zone, subzone (pressed = 1, released = 0 in index)
  uint8_t data[3] = { button_state, 0, 0 };
  vscp_node_send(VSCP_CLASS1_INFORMATION, VSCP_TYPE_INFORMATION_BUTTON, data, sizeof(data));
}
static K_WORK_DEFINE(button_work, button_work_handler);

static void
button_changed(uint32_t state, uint32_t has_changed)
{
  if (has_changed & DK_BTN1_MSK) {
    button_state = (state & DK_BTN1_MSK) ? 1 : 0;
    k_work_submit(&button_work);
  }
}

// Development GUID FF:FF:FF:FF:FF:FF:FF:FD + 8 octets of the FICR device
// id. Use a GUID from your own range in products.
static void
make_guid(uint8_t guid[16])
{
  uint8_t id[8] = { 0 };
  memset(guid, 0xFF, 7);
  guid[7] = 0xFD;
  hwinfo_get_device_id(id, sizeof(id));
  memcpy(guid + 8, id, 8);
}

static float
read_temperature(void)
{
  struct sensor_value v;
  if (temp_dev && device_is_ready(temp_dev) && !sensor_sample_fetch(temp_dev) &&
      !sensor_channel_get(temp_dev, SENSOR_CHAN_DIE_TEMP, &v)) {
    return (float) sensor_value_to_double(&v);
  }
  return -273.15f;
}

int
main(void)
{
  dk_leds_init();
  dk_buttons_init(button_changed);

  vscp_node_config_t cfg = {
    .company   = CONFIG_VSCP_NODE_COMPANY_ID,
    .on_state  = on_state,
    .on_event  = on_event,
    .authorize = authorize,
  };
  make_guid(cfg.guid);
  if (vscp_node_start(&cfg)) {
    return 0;
  }
  uint32_t buttons = 0;
  dk_read_buttons(&buttons, NULL);
  if (buttons & DK_BTN2_MSK) {
    LOG_WRN("Button 2 held: erasing all bonds");
    vscp_node_unpair_all();
  }

  int64_t next_measurement = k_uptime_get();
  for (unsigned blink = 0;; blink++) {
    if (advertising) {
      dk_set_led(DK_LED1, blink & 1);
    }
    if (k_uptime_get() >= next_measurement) {
      next_measurement += CONFIG_VSCP_NODE_PERIOD_MS;
      float celsius = read_temperature();
      uint32_t u;
      memcpy(&u, &celsius, sizeof(u));
      // Byte 0: 0b101 32-bit float | unit 1 (Celsius) << 3 | sensor 0
      uint8_t data[5] = { 0xA0 | (1 << 3), (uint8_t) (u >> 24), (uint8_t) (u >> 16), (uint8_t) (u >> 8), (uint8_t) u };
      vscp_node_send(VSCP_CLASS1_MEASUREMENT, VSCP_TYPE_MEASUREMENT_TEMPERATURE, data, sizeof(data));
    }
    k_sleep(K_MSEC(500));
  }
  return 0;
}
```
